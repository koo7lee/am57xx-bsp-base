## conf/bblayers.conf
```bitbake
LCONF_VERSION = "6"

BBPATH = "${TOPDIR}"
BSPDIR := "${@os.path.abspath(os.path.dirname(d.getVar('FILE', True)) + '/../..')}"

BBFILES ?= ""
BBLAYERS = " \
  ${BSPDIR}/sources/poky/meta-processor-sdk \
  ${BSPDIR}/sources/poky/meta-arago/meta-arago-distro \
  ${BSPDIR}/sources/poky/meta-arago/meta-arago-extras \
  ${BSPDIR}/sources/meta-browser \
  ${BSPDIR}/sources/meta-qt5 \
  ${BSPDIR}/sources/meta-openembedded/meta-networking \
  ${BSPDIR}/sources/meta-openembedded/meta-ruby \
  ${BSPDIR}/sources/meta-openembedded/meta-python \
  ${BSPDIR}/sources/meta-openembedded/meta-oe \
  ${BSPDIR}/sources/meta-openembedded/meta-gnome \
  ${BSPDIR}/sources/meta-ti \
  ${BSPDIR}/sources/meta-linaro/meta-linaro-toolchain \
  ${BSPDIR}/sources/meta-linaro/meta-optee \
  ${BSPDIR}/sources/oe-core/meta \
  \
  ${BSPDIR}/sources/meta-wa \
"
```
